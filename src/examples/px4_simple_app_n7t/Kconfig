## src/examples/px4_simple_app_n7t/Kconfig
```kconfig
menuconfig EXAMPLES_PX4_SIMPLE_APP_N7T
	bool "px4_simple_app_n7t"
	default n
	---help---
		Enable support for px4_simple_app_n7t
```

## src/examples/px4_tutorial_mavlink_debug/Kconfig
```kconfig
menuconfig EXAMPLES_PX4_TUTORIAL_MAVLINK_DEBUG
	bool "px4_tutorial_mavlink_debug"
	default n
	---help---
		Enable support for px4_tutorial_mavlink_debug
```

## src/examples/work_item_autostart/Kconfig
```kconfig
menuconfig EXAMPLES_WORK_ITEM_AUTOSTART
	bool "work_item_autostart"
	default n
	---help---
		Enable support for work_item_autostart
```

## src/examples/work_item_tutorialt/Kconfig
```kconfig
menuconfig EXAMPLES_WORK_ITEM_TUTORIALT
	bool "work_item_tutorialT"
	default n
	---help---
		Enable support for work_item_tutorialT
```

## src/systemcmds/auto_preflight_check/Kconfig
```kconfig
menuconfig SYSTEMCMDS_AUTO_PREFLIGHT_CHECK
	bool "auto_preflight_check"
	default n
	---help---
		Enable support for auto_preflight_check
```
